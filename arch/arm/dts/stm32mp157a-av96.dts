// SPDX-License-Identifier: (GPL-2.0+ OR BSD-3-Clause)
/*
 * Copyright (C) STMicroelectronics 2018 - All Rights Reserved
 * Author: Alexandre Torgue <alexandre.torgue@st.com>.
 */

/dts-v1/;

#include "stm32mp157a-av96.dtsi"
#include <dt-bindings/rtc/rtc-stm32.h>

/ {
	model = "Arrow Electronics Avenger96 Board";
	compatible = "st,stm32mp157a-av96", "st,stm32mp157";
};

&rtc {
	st,lsco = <RTC_OUT2_RMP>;
	pinctrl-0 = <&rtc_out2_rmp_pins_a>;
	pinctrl-names = "default";
};

&rcc {
	pinctrl-names = "default", "sleep";
	pinctrl-0 = <&rcc_pins_a>;
	pinctrl-1 = <&rcc_sleep_pins_a>;
	status = "okay";
};
